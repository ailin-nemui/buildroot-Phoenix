## packages/irssi-git/Config.in
```kconfig
config BR2_PACKAGE_IRSSI_GIT
	bool "irssi (git)"
	depends on BR2_USE_WCHAR # libglib2
	depends on BR2_TOOLCHAIN_HAS_THREADS # libglib2
	depends on BR2_USE_MMU # fork()
	select BR2_PACKAGE_LIBGLIB2
	select BR2_PACKAGE_NCURSES
	select BR2_PACKAGE_OPENSSL
	help
	  Irssi is a terminal based IRC client for UNIX systems.

	  http://irssi.org/

if BR2_PACKAGE_IRSSI_GIT

config BR2_PACKAGE_IRSSI_GIT_LIBOTR
	bool "OTR messaging support"
	select BR2_PACKAGE_LIBOTR
	help
	  Enable off-the-record messaging support in irssi.

config BR2_PACKAGE_IRSSI_GIT_PERL
	bool "perl support"
	select BR2_PACKAGE_PERL
	help
	  Enable perl interpreter support.

config BR2_PACKAGE_IRSSI_GIT_PROXY
	bool "proxy module"
	help
	  Build the irssi proxy module, which allows an IRC connection
	  to be shared among multiple clients.

config BR2_PACKAGE_IRSSI_GIT_TIME_SCRIPTS
	bool "enable support for scripts such as server time and auto away"
	select BR2_PACKAGE_PERL_DATETIME_FORMAT_ISO8601
	help
	  This enables support for scripts such as server time.

	  These require the addition of several perl modules.

	  This config option *DOES NOT* install scripts.

	  It merely selects the required modules for perl.

config BR2_PACKAGE_IRSSI_GIT_TRUE_COLOR
	bool "true color support"
	help
	  Build with true color support in terminal.

endif

comment "irssi needs a toolchain w/ wchar, threads"
	depends on BR2_USE_MMU
	depends on !BR2_USE_WCHAR || !BR2_TOOLCHAIN_HAS_THREADS
```

## packages/libotr/Config.in
```kconfig
config BR2_PACKAGE_LIBOTR
	bool "libotr"
	select libgcrypt
	select libgpg-error
	help
	  Off-the-record messaging library.

	  https://otr.cypherpunks.ca
```

## packages/lifepo4wered-pi/Config.in
```kconfig
config BR2_PACKAGE_LIFEPO4WERED_PI
	bool "LiFePO4wered-Pi"
	help
	  Access library, command line tool and daemon
	  for the LiFePO4wered/Pi module.

	  https://github.com/xorbit/LiFePO4wered-Pi
```

## packages/perl-libs/perl-class-singleton/Config.in
```kconfig
config BR2_PACKAGE_PERL_CLASS_SINGLETON
	bool "perl-class-singleton"
	help
	  Implementation of a "Singleton" class.

	  https://metacpan.org/release/Class-Singleton
```

## packages/perl-libs/perl-datetime-format-builder/Config.in
```kconfig
config BR2_PACKAGE_PERL_DATETIME_FORMAT_BUILDER
	bool "perl-datetime-format-builder"
	depends on !BR2_STATIC_LIBS
	select BR2_PACKAGE_PERL_DATETIME # runtime
	select BR2_PACKAGE_PERL_DATETIME_FORMAT_STRPTIME # runtime
	select BR2_PACKAGE_PERL_PARAMS_VALIDATE # runtime
	help
	  Create DateTime parser classes and objects.

	  https://metacpan.org/release/DateTime-Format-Builder

comment "perl-datetime-format-builder needs a toolchain w/ dynamic library"
	depends on BR2_STATIC_LIBS
```

## packages/perl-libs/perl-datetime-format-iso8601/Config.in
```kconfig
config BR2_PACKAGE_PERL_DATETIME_FORMAT_ISO8601
	bool "perl-datetime-format-iso8601"
	depends on !BR2_STATIC_LIBS
	select BR2_PACKAGE_PERL_DATETIME # runtime
	select BR2_PACKAGE_PERL_DATETIME_FORMAT_BUILDER # runtime
	select BR2_PACKAGE_PERL_PARAMS_VALIDATIONCOMPILER # runtime
	select BR2_PACKAGE_PERL_SPECIO # runtime
	select BR2_PACKAGE_PERL_NAMESPACE_AUTOCLEAN # runtime
	help
	  Parses ISO8601 formats.

	  https://metacpan.org/release/DateTime-HiRes

comment "perl-datetime-format-iso8601 needs a toolchain w/ dynamic library"
	depends on BR2_STATIC_LIBS
```

## packages/perl-libs/perl-datetime-format-strptime/Config.in
```kconfig
config BR2_PACKAGE_PERL_DATETIME_FORMAT_STRPTIME
	bool "perl-datetime-format-strptime"
	depends on !BR2_STATIC_LIBS
	select BR2_PACKAGE_PERL_DATETIME # runtime
	select BR2_PACKAGE_PERL_DATETIME_LOCALE # runtime
	select BR2_PACKAGE_PERL_DATETIME_TIMEZONE # runtime
	select BR2_PACKAGE_PERL_PARAMS_VALIDATIONCOMPILER # runtime
	select BR2_PACKAGE_PERL_SPECIO # runtime
	select BR2_PACKAGE_PERL_TRY_TINY # runtime
	help
	  Parse and format strp and strf time patterns.

	  http://metacpan.org/release/DateTime-Format-Strptime

comment "perl-datetime-format-strptime needs a toolchain w/ dynamic library"
	depends on BR2_STATIC_LIBS
```

## packages/perl-libs/perl-datetime-locale/Config.in
```kconfig
config BR2_PACKAGE_PERL_DATETIME_LOCALE
	bool "perl-datetime-locale"
	depends on !BR2_STATIC_LIBS
	select BR2_PACKAGE_PERL_DIST_CHECKCONFLICTS # runtime
	select BR2_PACKAGE_PERL_FILE_SHAREDIR # runtime
	select BR2_PACKAGE_PERL_PARAMS_VALIDATIONCOMPILER # runtime
	select BR2_PACKAGE_PERL_SPECIO # runtime
	select BR2_PACKAGE_PERL_NAMESPACE_AUTOCLEAN # runtime
	help
	  Localization support for DateTime.pm.

	  https://metacpan.org/release/DateTime-Locale

comment "perl-datetime-locale needs a toolchain w/ dynamic library"
	depends on BR2_STATIC_LIBS
```

## packages/perl-libs/perl-datetime-timezone/Config.in
```kconfig
config BR2_PACKAGE_PERL_DATETIME_TIMEZONE
	bool "perl-datetime-timezone"
	depends on !BR2_STATIC_LIBS
	select BR2_PACKAGE_PERL_CLASS_SINGLETON # runtime
	select BR2_PACKAGE_PERL_MODULE_RUNTIME # runtime
	select BR2_PACKAGE_PERL_PARAMS_VALIDATIONCOMPILER # runtime
	select BR2_PACKAGE_PERL_SPECIO # runtime
	select BR2_PACKAGE_PERL_TRY_TINY # runtime
	select BR2_PACKAGE_PERL_NAMESPACE_AUTOCLEAN # runtime
	help
	  Time zone object base class and factory.

	  https://metacpan.org/release/DateTime-TimeZone

comment "perl-datetime-timezone needs a toolchain w/ dynamic library"
	depends on BR2_STATIC_LIBS
```

## packages/perl-libs/perl-datetime/Config.in
```kconfig
config BR2_PACKAGE_PERL_DATETIME
	bool "perl-datetime"
	depends on !BR2_STATIC_LIBS
	select BR2_PACKAGE_PERL_DATETIME_LOCALE # runtime
	select BR2_PACKAGE_PERL_DATETIME_TIMEZONE # runtime
	select BR2_PACKAGE_PERL_DIST_CHECKCONFLICTS # runtime
	select BR2_PACKAGE_PERL_PARAMS_VALIDATIONCOMPILER # runtime
	select BR2_PACKAGE_PERL_SPECIO # runtime
	select BR2_PACKAGE_PERL_TRY_TINY # runtime
	select BR2_PACKAGE_PERL_NAMESPACE_AUTOCLEAN # runtime
	help
	  A date and time object for Perl.

	  https://metacpan.org/release/DateTime

comment "perl-datetime needs a toolchain w/ dynamic library"
	depends on BR2_STATIC_LIBS
```

## packages/perl-libs/perl-eval-closure/Config.in
```kconfig
config BR2_PACKAGE_PERL_EVAL_CLOSURE
	bool "perl-eval-closure"
	help
	  safely and cleanly create closures via string eval.

	  http://metacpan.org/release/Eval-Closure
```

## packages/perl-libs/perl-exception-class/Config.in
```kconfig
config BR2_PACKAGE_PERL_EXCEPTION_CLASS
	bool "perl-exception-class"
	select BR2_PACKAGE_PERL_CLASS_DATA_INHERITABLE # runtime
	select BR2_PACKAGE_PERL_DEVEL_STACKTRACE # runtime
	help
	  A module that allows you to declare real exception classes in
	  Perl.

	  http://metacpan.org/release/Exception-Class
```

## packages/perl-libs/perl-namespace-autoclean/Config.in
```kconfig
config BR2_PACKAGE_PERL_NAMESPACE_AUTOCLEAN
	bool "perl-namespace-autoclean"
	depends on !BR2_STATIC_LIBS
	select BR2_PACKAGE_PERL_B_HOOKS_ENDOFSCOPE # runtime
	select BR2_PACKAGE_PERL_SUB_IDENTIFY # runtime
	select BR2_PACKAGE_PERL_NAMESPACE_CLEAN # runtime
	help
	  Keep imports out of your namespace.

	  https://github.com/moose/namespace-autoclean

comment "perl-namespace-autoclean needs a toolchain w/ dynamic library"
	depends on BR2_STATIC_LIBS
```

## packages/perl-libs/perl-namespace-clean/Config.in
```kconfig
config BR2_PACKAGE_PERL_NAMESPACE_CLEAN
	bool "perl-namespace-clean"
	select BR2_PACKAGE_PERL_B_HOOKS_ENDOFSCOPE # runtime
	select BR2_PACKAGE_PERL_PACKAGE_STASH # runtime
	help
	  Keep imports and functions out of your namespace.

	  http://search.cpan.org/dist/namespace-clean
```

## packages/perl-libs/perl-params-validate/Config.in
```kconfig
config BR2_PACKAGE_PERL_PARAMS_VALIDATE
	bool "perl-params-validate"
	depends on !BR2_STATIC_LIBS
	select BR2_PACKAGE_PERL_MODULE_IMPLEMENTATION # runtime
	help
	  Validate method/function parameters.

	  https://metacpan.org/release/Params-Validate

comment "perl-params-validate needs a toolchain w/ dynamic library"
	depends on BR2_STATIC_LIBS
```

## packages/perl-libs/perl-params-validationcompiler/Config.in
```kconfig
config BR2_PACKAGE_PERL_PARAMS_VALIDATIONCOMPILER
	bool "perl-params-validationcompiler"
	select BR2_PACKAGE_PERL_EVAL_CLOSURE # runtime
	select BR2_PACKAGE_PERL_EXCEPTION_CLASS # runtime
	help
	  Build an optimized subroutine parameter validator once, use
	  it forever.

	  http://metacpan.org/release/Params-ValidationCompiler
```
