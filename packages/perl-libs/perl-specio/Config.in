## packages/perl-libs/perl-specio/Config.in
```kconfig
config BR2_PACKAGE_PERL_SPECIO
	bool "perl-specio"
	select BR2_PACKAGE_PERL_DEVEL_STACKTRACE # runtime
	select BR2_PACKAGE_PERL_EVAL_CLOSURE # runtime
	select BR2_PACKAGE_PERL_MRO_COMPAT # runtime
	select BR2_PACKAGE_PERL_MODULE_RUNTIME # runtime
	select BR2_PACKAGE_PERL_ROLE_TINY # runtime
	select BR2_PACKAGE_PERL_SUB_QUOTE # runtime
	select BR2_PACKAGE_PERL_TRY_TINY # runtime
	help
	  Type constraints and coercions for Perl.

	  https://metacpan.org/release/Specio
```

## packages/perl-libs/perl-sub-identify/Config.in
```kconfig
config BR2_PACKAGE_PERL_SUB_IDENTIFY
	bool "perl-sub-identify"
	depends on !BR2_STATIC_LIBS
	help
	  Retrieve names of code references.

	  https://metacpan.org/release/Sub-Identify

comment "perl-sub-identify needs a toolchain w/ dynamic library"
	depends on BR2_STATIC_LIBS
```

## packages/polkit-duktape/Config.in
```kconfig
config BR2_PACKAGE_POLKIT_DUKTAPE
	bool "polkit-duktape"
	depends on BR2_USE_MMU # libglib2, dbus
	depends on BR2_USE_WCHAR # libglib2
	select BR2_PACKAGE_DBUS # runtime
	select BR2_PACKAGE_EXPAT
	select BR2_PACKAGE_LIBGLIB2
	select BR2_PACKAGE_DUKTAPE_PC
	help
	  PolicyKit is a toolkit for defining and handling
	  authorizations. It is used for allowing unprivileged
	  processes to speak to privileged processes.

	  http://www.freedesktop.org/wiki/Software/polkit

comment "polkit needs a toolchain with wchar, dynamic library"
	depends on BR2_USE_MMU
```
